## boards/arm/nimble_dk/Kconfig.board
```kconfig
# Copyright (c) 2023 juskim (GitHub: jus-kim, YouTube: @juskim)
# SPDX-License-Identifier: Apache-2.0

config BOARD_NIMBLE_DK
	bool "nimBLE DK"
	depends on SOC_NRF52833_QIAA
```

## boards/arm/nimble_dk/Kconfig.defconfig
```kconfig
# Copyright (c) 2023 juskim (GitHub: jus-kim, YouTube: @juskim)
# SPDX-License-Identifier: Apache-2.0

if BOARD_NIMBLE_DK

config BOARD
	default "nimble_dk"

config BT_CTLR
   default BT

endif
```

## boards/arm/nimble_dk/nimble_dk_defconfig
```kconfig
# Copyright (c) 2023 juskim (GitHub: jus-kim, YouTube: @juskim)
# SPDX-License-Identifier: Apache-2.0

CONFIG_SOC_SERIES_NRF52X=y
CONFIG_SOC_NRF52833_QIAA=y
CONFIG_BOARD_NIMBLE_DK=y

# Enable common HW/SW settings
CONFIG_NEWLIB_LIBC=y
CONFIG_NEWLIB_LIBC_NANO=n
CONFIG_APPLICATION_DEFINED_SYSCALL=y
CONFIG_FPU=y
CONFIG_PINCTRL=y
CONFIG_ARM_MPU=y
CONFIG_HW_STACK_PROTECTION=y
CONFIG_PM=y
CONFIG_PM_DEVICE=y
CONFIG_SERIAL=y
CONFIG_CONSOLE=n
CONFIG_NRFX_POWER=y
CONFIG_HEAP_MEM_POOL_SIZE=2048
CONFIG_SYSTEM_WORKQUEUE_STACK_SIZE=2048

# Config logger to work only on SEGGER RTT
CONFIG_LOG=y
CONFIG_LOG_BACKEND_RTT=y
CONFIG_LOG_BACKEND_UART=n
CONFIG_LOG_PRINTK=n
CONFIG_LOG_MODE_IMMEDIATE=y
CONFIG_USE_SEGGER_RTT=y
CONFIG_RTT_CONSOLE=n

# Enable the UART driver
CONFIG_UART_ASYNC_API=y
CONFIG_UART_LINE_CTRL=y
CONFIG_UART_INTERRUPT_DRIVEN=y
CONFIG_NRFX_UARTE0=y
CONFIG_UART_CONSOLE=n

# Enable BLE
CONFIG_BT=y
CONFIG_BT_PERIPHERAL=y
CONFIG_BT_DEVICE_NAME="tinyCybertruck"
CONFIG_BT_DEVICE_APPEARANCE=833
CONFIG_BT_MAX_CONN=1
CONFIG_BT_MAX_PAIRED=1

# Enable BLE bonding
CONFIG_FLASH=n
CONFIG_FLASH_PAGE_LAYOUT=n
CONFIG_FLASH_MAP=n
CONFIG_NVS=n
CONFIG_SETTINGS=n
CONFIG_BT_SETTINGS=n

# Enable the NUS service
CONFIG_BT_NUS=y

# Enable Zephyr shell related modules
CONFIG_PRINTK=y
CONFIG_SHELL=y
CONFIG_INIT_STACKS=y
CONFIG_THREAD_STACK_INFO=y
CONFIG_KERNEL_SHELL=y
CONFIG_THREAD_MONITOR=y
CONFIG_BOOT_BANNER=y
CONFIG_THREAD_NAME=y
CONFIG_DEVICE_SHELL=y
CONFIG_POSIX_CLOCK=y
CONFIG_DATE_SHELL=y
CONFIG_THREAD_RUNTIME_STATS=y
CONFIG_THREAD_RUNTIME_STATS_USE_TIMING_FUNCTIONS=y
CONFIG_STATS=y
CONFIG_STATS_SHELL=y
CONFIG_SHELL_PROMPT_UART="> "

# Enable USB CDC ACM
CONFIG_USB_DEVICE_STACK=y
CONFIG_USB_DEVICE_PRODUCT="tinyCybertruck"
CONFIG_USB_DEVICE_MANUFACTURER="juskim"
CONFIG_SHELL_BACKEND_SERIAL_CHECK_DTR=y
CONFIG_SHELL_BACKEND_SERIAL_INIT_PRIORITY=51
#CONFIG_USB_DEVICE_INITIALIZE_AT_BOOT=n
CONFIG_USB_DEVICE_VID=0x0001
CONFIG_USB_DEVICE_PID=0x0002
CONFIG_USB_CDC_ACM_LOG_LEVEL_OFF=y
```

## src/Kconfig
```kconfig
#
# Copyright (c) 2023 juskim. All rights reserved.
# GitHub: jus-kim, YouTube: @juskim
#

rsource "driver/Kconfig"
rsource "lib/Kconfig"
rsource "profile/Kconfig"
```

## src/driver/Kconfig
```kconfig
#
# Copyright (c) 2023 juskim. All rights reserved.
# GitHub: jus-kim, YouTube: @juskim
#

menu "Drivers"
rsource "bat_charger/Kconfig"
rsource "led_drivers/Kconfig"
rsource "motors/Kconfig"
endmenu
```

## src/driver/bat_charger/Kconfig
```kconfig
#
# Copyright (c) 2023 juskim. All rights reserved.
# GitHub: jus-kim, YouTube: @juskim
#
# Battery charger driver configuration options
#

menuconfig BAT_CHARGER
	bool "Battery charger"
	default y
	help
	  Enable battery charger driver.


if BAT_CHARGER

config MCP73831
	bool "MCP73831 driver"
	default y
	depends on GPIO
	help
	  Enable MCP73831 battery charger driver.

endif # BAT_CHARGER
```

## src/driver/led_drivers/Kconfig
```kconfig
#
# Copyright (c) 2023 juskim. All rights reserved.
# GitHub: jus-kim, YouTube: @juskim
#
# LED drivers configuration options
#

menuconfig LED_DRIVERS
	bool "LED drivers"
	default y
	help
	  Enable LED drivers driver.


if LED_DRIVERS

config LTC3220
	bool "LTC3220 LED drivers"
	default y
	depends on I2C && GPIO
	help
	  Enable LTC3220 LED drivers.

endif # LED_DRIVERS
```

## src/driver/motors/Kconfig
```kconfig
#
# Copyright (c) 2023 juskim. All rights reserved.
# GitHub: jus-kim, YouTube: @juskim
#
# DRV8220 and A4988 motors driver configuration options
#

menuconfig MOTORS_DRV
	bool "Motors driver"
	default y
	help
	  Enable motors driver for DRV8220 and A4988.


if MOTORS_DRV

#config DRV8220
#	bool "DRV8220 DC motor"
#	default y
#	depends on PWM && GPIO
#	help
#	  Enable PWM-based driver for DRV8220 based motors driver.

endif # MOTORS_DRV
```

## src/lib/Kconfig
```kconfig
#
# Copyright (c) 2023 juskim. All rights reserved.
# GitHub: jus-kim, YouTube: @juskim
#

menu "Libraries"
rsource "ble/Kconfig"
endmenu
```

## src/profile/Kconfig
```kconfig
#
# Copyright (c) 2023 juskim. All rights reserved.
# GitHub: jus-kim, YouTube: @juskim
#

menu "Profiles"
rsource "tinyrc/Kconfig"
endmenu
```

## src/profile/tinyrc/Kconfig
```kconfig
#
# Copyright (c) 2023 juskim. All rights reserved.
# GitHub: jus-kim, YouTube: @juskim
#
# Battery charger driver configuration options
#

menuconfig PROFILE_TINYRC
	bool "OS profile for tinyRCr"
	default y
	depends on GPIO && PWM && I2C && MOTORS_DRV && LED_DRIVERS && LTC3220 && BAT_CHARGER && MCP73831
	help
	  Enable tinyRC OS profile.


if PROFILE_TINYRC

#config MCP73831
#	bool "MCP73831 driver"
#	default y
#	depends on GPIO
#	help
#	  Enable MCP73831 battery charger driver.

endif # PROFILE_TINYRC
```
